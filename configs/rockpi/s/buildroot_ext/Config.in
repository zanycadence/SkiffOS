## configs/rockpi/s/buildroot_ext/package/rockpi-firmware/Config.in
```kconfig
config BR2_PACKAGE_ROCKPI_FIRMWARE
	bool "rockpi-firmware"
	help
	  RockPi extra binaries and firmware.

	  https://github.com/radxa/rkbin
```
